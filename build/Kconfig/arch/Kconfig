## build/Kconfig/arch/Kconfig
```kconfig
# Load Zephyr Arch Kconfig descriptions.
osource "C:/Amrith/zephyr/zephyr/arch/rx/Kconfig"
osource "C:/Amrith/zephyr/zephyr/arch/x86/Kconfig"
osource "C:/Amrith/zephyr/zephyr/arch/xtensa/Kconfig"
osource "C:/Amrith/zephyr/zephyr/arch/sparc/Kconfig"
osource "C:/Amrith/zephyr/zephyr/arch/riscv/Kconfig"
osource "C:/Amrith/zephyr/zephyr/arch/posix/Kconfig"
osource "C:/Amrith/zephyr/zephyr/arch/openrisc/Kconfig"
osource "C:/Amrith/zephyr/zephyr/arch/mips/Kconfig"
osource "C:/Amrith/zephyr/zephyr/arch/arm64/Kconfig"
osource "C:/Amrith/zephyr/zephyr/arch/arm/Kconfig"
osource "C:/Amrith/zephyr/zephyr/arch/arc/Kconfig"
```

## build/Kconfig/boards/Kconfig.defconfig.tmp
```kconfig
# Load Zephyr board defconfig descriptions.
osource "C:/Amrith/zephyr/zephyr/boards/nxp/frdm_mcxn236/Kconfig.defconfig"
```

## build/Kconfig/boards/Kconfig.frdm_mcxn236.tmp
```kconfig
# Load board Kconfig descriptions.
osource "C:/Amrith/zephyr/zephyr/boards/nxp/frdm_mcxn236/Kconfig.frdm_mcxn236"
```

## build/Kconfig/boards/Kconfig.tmp
```kconfig
# Load Zephyr board Kconfig descriptions.
osource "C:/Amrith/zephyr/zephyr/boards/nxp/frdm_mcxn236/Kconfig"
```

## build/Kconfig/soc/Kconfig.tmp
```kconfig
# Load Zephyr SoC Kconfig descriptions.
osource "C:/Amrith/zephyr/zephyr/soc/xlnx/zynqmp/Kconfig"
osource "C:/Amrith/zephyr/zephyr/soc/xlnx/zynq7000/Kconfig"
osource "C:/Amrith/zephyr/zephyr/soc/xlnx/versalnet/Kconfig"
osource "C:/Amrith/zephyr/zephyr/soc/xlnx/versal2/Kconfig"
osource "C:/Amrith/zephyr/zephyr/soc/xlnx/versal/Kconfig"
osource "C:/Amrith/zephyr/zephyr/soc/xen/Kconfig"
osource "C:/Amrith/zephyr/zephyr/soc/wch/ch32v/Kconfig"
osource "C:/Amrith/zephyr/zephyr/soc/ti/simplelink/Kconfig"
osource "C:/Amrith/zephyr/zephyr/soc/ti/mspm0/Kconfig"
osource "C:/Amrith/zephyr/zephyr/soc/ti/lm3s6965/Kconfig"
osource "C:/Amrith/zephyr/zephyr/soc/ti/k3/Kconfig"
osource "C:/Amrith/zephyr/zephyr/soc/telink/tlsr/Kconfig"
osource "C:/Amrith/zephyr/zephyr/soc/syna/sr100/Kconfig"
osource "C:/Amrith/zephyr/zephyr/soc/starfive/jh71xx/Kconfig"
osource "C:/Amrith/zephyr/zephyr/soc/st/stm32/Kconfig"
osource "C:/Amrith/zephyr/zephyr/soc/snps/qemu_arc/Kconfig"
osource "C:/Amrith/zephyr/zephyr/soc/snps/nsim/arc_v/Kconfig"
osource "C:/Amrith/zephyr/zephyr/soc/snps/nsim/arc_classic/Kconfig"
osource "C:/Amrith/zephyr/zephyr/soc/snps/hsdk4xd/Kconfig"
osource "C:/Amrith/zephyr/zephyr/soc/snps/hsdk/Kconfig"
osource "C:/Amrith/zephyr/zephyr/soc/snps/emsk/Kconfig"
osource "C:/Amrith/zephyr/zephyr/soc/snps/emsdp/Kconfig"
osource "C:/Amrith/zephyr/zephyr/soc/snps/arc_iot/Kconfig"
osource "C:/Amrith/zephyr/zephyr/soc/silabs/Kconfig"
osource "C:/Amrith/zephyr/zephyr/soc/sifli/sf32/Kconfig"
osource "C:/Amrith/zephyr/zephyr/soc/sifive/sifive_freedom/Kconfig"
osource "C:/Amrith/zephyr/zephyr/soc/sensry/Kconfig"
osource "C:/Amrith/zephyr/zephyr/soc/rockchip/Kconfig"
osource "C:/Amrith/zephyr/zephyr/soc/renode/riscv_virtual/Kconfig"
osource "C:/Amrith/zephyr/zephyr/soc/renode/cortex_r8_virtual/Kconfig"
osource "C:/Amrith/zephyr/zephyr/soc/renesas/smartbond/Kconfig"
osource "C:/Amrith/zephyr/zephyr/soc/renesas/rz/Kconfig"
osource "C:/Amrith/zephyr/zephyr/soc/renesas/rx/Kconfig"
osource "C:/Amrith/zephyr/zephyr/soc/renesas/rcar/Kconfig"
osource "C:/Amrith/zephyr/zephyr/soc/renesas/ra/Kconfig"
osource "C:/Amrith/zephyr/zephyr/soc/realtek/fingerprint/Kconfig"
osource "C:/Amrith/zephyr/zephyr/soc/realtek/ec/Kconfig"
osource "C:/Amrith/zephyr/zephyr/soc/realtek/bee/Kconfig"
osource "C:/Amrith/zephyr/zephyr/soc/realtek/ameba/Kconfig"
osource "C:/Amrith/zephyr/zephyr/soc/raspberrypi/rpi_pico/Kconfig"
osource "C:/Amrith/zephyr/zephyr/soc/quicklogic/eos_s3/Kconfig"
osource "C:/Amrith/zephyr/zephyr/soc/qemu/virt_riscv/Kconfig"
osource "C:/Amrith/zephyr/zephyr/soc/qemu/or1k/Kconfig"
osource "C:/Amrith/zephyr/zephyr/soc/qemu/malta/Kconfig"
osource "C:/Amrith/zephyr/zephyr/soc/openisa/rv32m1/Kconfig"
osource "C:/Amrith/zephyr/zephyr/soc/openhwgroup/cva6/Kconfig"
osource "C:/Amrith/zephyr/zephyr/soc/oct/osd32mp15x/Kconfig"
osource "C:/Amrith/zephyr/zephyr/soc/nxp/s32/Kconfig"
osource "C:/Amrith/zephyr/zephyr/soc/nxp/rw/Kconfig"
osource "C:/Amrith/zephyr/zephyr/soc/nxp/mcx/Kconfig"
osource "C:/Amrith/zephyr/zephyr/soc/nxp/lpc/Kconfig"
osource "C:/Amrith/zephyr/zephyr/soc/nxp/layerscape/Kconfig"
osource "C:/Amrith/zephyr/zephyr/soc/nxp/kinetis/Kconfig"
osource "C:/Amrith/zephyr/zephyr/soc/nxp/imxrt/Kconfig"
osource "C:/Amrith/zephyr/zephyr/soc/nxp/imx/Kconfig"
osource "C:/Amrith/zephyr/zephyr/soc/nuvoton/numicro/Kconfig"
osource "C:/Amrith/zephyr/zephyr/soc/nuvoton/numaker/Kconfig"
osource "C:/Amrith/zephyr/zephyr/soc/nuvoton/npcx/Kconfig"
osource "C:/Amrith/zephyr/zephyr/soc/nuvoton/npcm/Kconfig"
osource "C:/Amrith/zephyr/zephyr/soc/nordic/Kconfig"
osource "C:/Amrith/zephyr/zephyr/soc/neorv32/Kconfig"
osource "C:/Amrith/zephyr/zephyr/soc/native/inf_clock/Kconfig"
osource "C:/Amrith/zephyr/zephyr/soc/microchip/sam/sama7/Kconfig"
osource "C:/Amrith/zephyr/zephyr/soc/microchip/sam/sam_d5x_e5x/Kconfig"
osource "C:/Amrith/zephyr/zephyr/soc/microchip/pic64/Kconfig"
osource "C:/Amrith/zephyr/zephyr/soc/microchip/pic32c/pic32cz_ca/Kconfig"
osource "C:/Amrith/zephyr/zephyr/soc/microchip/pic32c/pic32cx_sg/Kconfig"
osource "C:/Amrith/zephyr/zephyr/soc/microchip/pic32c/pic32cm_pl/Kconfig"
osource "C:/Amrith/zephyr/zephyr/soc/microchip/pic32c/pic32cm_jh/Kconfig"
osource "C:/Amrith/zephyr/zephyr/soc/microchip/miv/Kconfig"
osource "C:/Amrith/zephyr/zephyr/soc/microchip/mec/Kconfig"
osource "C:/Amrith/zephyr/zephyr/soc/mediatek/mt8xxx/Kconfig"
osource "C:/Amrith/zephyr/zephyr/soc/lowrisc/opentitan/Kconfig"
osource "C:/Amrith/zephyr/zephyr/soc/litex/litex_vexriscv/Kconfig"
osource "C:/Amrith/zephyr/zephyr/soc/ite/ec/Kconfig"
osource "C:/Amrith/zephyr/zephyr/soc/intel/wildcat_lake/Kconfig"
osource "C:/Amrith/zephyr/zephyr/soc/intel/raptor_lake/Kconfig"
osource "C:/Amrith/zephyr/zephyr/soc/intel/panther_lake/Kconfig"
osource "C:/Amrith/zephyr/zephyr/soc/intel/lakemont/Kconfig"
osource "C:/Amrith/zephyr/zephyr/soc/intel/intel_socfpga_std/Kconfig"
osource "C:/Amrith/zephyr/zephyr/soc/intel/intel_socfpga/Kconfig"
osource "C:/Amrith/zephyr/zephyr/soc/intel/intel_niosv/Kconfig"
osource "C:/Amrith/zephyr/zephyr/soc/intel/intel_ish/Kconfig"
osource "C:/Amrith/zephyr/zephyr/soc/intel/intel_adsp/Kconfig"
osource "C:/Amrith/zephyr/zephyr/soc/intel/elkhart_lake/Kconfig"
osource "C:/Amrith/zephyr/zephyr/soc/intel/atom/Kconfig"
osource "C:/Amrith/zephyr/zephyr/soc/intel/apollo_lake/Kconfig"
osource "C:/Amrith/zephyr/zephyr/soc/intel/alder_lake/Kconfig"
osource "C:/Amrith/zephyr/zephyr/soc/infineon/psoc4/Kconfig"
osource "C:/Amrith/zephyr/zephyr/soc/infineon/edge/Kconfig"
osource "C:/Amrith/zephyr/zephyr/soc/infineon/cat3/Kconfig"
osource "C:/Amrith/zephyr/zephyr/soc/infineon/cat1c/Kconfig"
osource "C:/Amrith/zephyr/zephyr/soc/infineon/cat1b/Kconfig"
osource "C:/Amrith/zephyr/zephyr/soc/infineon/cat1a/Kconfig"
osource "C:/Amrith/zephyr/zephyr/soc/gd/gd32/Kconfig"
osource "C:/Amrith/zephyr/zephyr/soc/gaisler/leon3/Kconfig"
osource "C:/Amrith/zephyr/zephyr/soc/gaisler/gr716a/Kconfig"
osource "C:/Amrith/zephyr/zephyr/soc/focaltech/Kconfig"
osource "C:/Amrith/zephyr/zephyr/soc/espressif/Kconfig"
osource "C:/Amrith/zephyr/zephyr/soc/ene/kb1200/Kconfig"
osource "C:/Amrith/zephyr/zephyr/soc/ene/kb106x/Kconfig"
osource "C:/Amrith/zephyr/zephyr/soc/elan/em32f967/Kconfig"
osource "C:/Amrith/zephyr/zephyr/soc/egis/Kconfig"
osource "C:/Amrith/zephyr/zephyr/soc/efinix/sapphire/Kconfig"
osource "C:/Amrith/zephyr/zephyr/soc/cdns/xtensa_sample_controller/Kconfig"
osource "C:/Amrith/zephyr/zephyr/soc/cdns/swerv/Kconfig"
osource "C:/Amrith/zephyr/zephyr/soc/cdns/sample_controller32/Kconfig"
osource "C:/Amrith/zephyr/zephyr/soc/cdns/dc233c/Kconfig"
osource "C:/Amrith/zephyr/zephyr/soc/brcm/bcmvk/Kconfig"
osource "C:/Amrith/zephyr/zephyr/soc/brcm/bcm2712/Kconfig"
osource "C:/Amrith/zephyr/zephyr/soc/brcm/bcm2711/Kconfig"
osource "C:/Amrith/zephyr/zephyr/soc/blackberry/qnxhv_vm/Kconfig"
osource "C:/Amrith/zephyr/zephyr/soc/bflb/Kconfig"
osource "C:/Amrith/zephyr/zephyr/soc/atmel/sam0/Kconfig"
osource "C:/Amrith/zephyr/zephyr/soc/atmel/sam/Kconfig"
osource "C:/Amrith/zephyr/zephyr/soc/aspeed/Kconfig"
osource "C:/Amrith/zephyr/zephyr/soc/arm/Kconfig"
osource "C:/Amrith/zephyr/zephyr/soc/arm/beetle/Kconfig"
osource "C:/Amrith/zephyr/zephyr/soc/antmicro/myra/Kconfig"
osource "C:/Amrith/zephyr/zephyr/soc/andestech/Kconfig"
osource "C:/Amrith/zephyr/zephyr/soc/amd/acp_6_0/Kconfig"
osource "C:/Amrith/zephyr/zephyr/soc/ambiq/Kconfig"
osource "C:/Amrith/zephyr/zephyr/soc/allwinner/sun8i_h3/Kconfig"
osource "C:/Amrith/zephyr/zephyr/soc/alif/ensemble/Kconfig"
osource "C:/Amrith/zephyr/zephyr/soc/aesc/Kconfig"
osource "C:/Amrith/zephyr/zephyr/soc/adi/max32/Kconfig"
```
