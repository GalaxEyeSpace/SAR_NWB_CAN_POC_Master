## CMakeLists.txt
```
cmake_minimum_required(VERSION 3.20.0)

if(NOT BOARD)
  set(BOARD frdm_mcxn236)
endif()

find_package(Zephyr REQUIRED HINTS $ENV{ZEPHYR_BASE})
project(POC_CANopen_SlaveSW)

set(CO_DIR ${CMAKE_CURRENT_SOURCE_DIR}/CANopenNode)

# CANopenNode v4 stack sources (CiA 301 core + optional modules we may use)
file(GLOB CO_301_SOURCES ${CO_DIR}/301/*.c)
file(GLOB CO_303_SOURCES ${CO_DIR}/303/*.c)
file(GLOB CO_305_SOURCES ${CO_DIR}/305/*.c)
set(CO_STORAGE_SOURCES ${CO_DIR}/storage/CO_storage.c)

zephyr_compile_definitions(SYS_CONST_DEBUG=0)

target_sources(app PRIVATE
  ${CO_DIR}/CANopen.c
  ${CO_301_SOURCES}
  ${CO_303_SOURCES}
  ${CO_305_SOURCES}
  ${CO_STORAGE_SOURCES}

  src/main.c
  src/CO_driver.c
  src/CO_storageBlank.c
  src/OD.c
  src/app_uart.c
)

target_include_directories(app PRIVATE
  src              # first: our CO_driver.h and OD.h
  src/APP
  ${CO_DIR}
)
```

## Kconfig
```
mainmenu "POC_CANopen_Master"

config MASTER_NODE_ID
	int "CANopen node-ID of the master"
	range 1 127
	default 1

source "Kconfig.zephyr"
```

## prj.conf
```kconfig
CONFIG_CAN=y
CONFIG_PRINTK=y
CONFIG_LOG=y
CONFIG_MAIN_STACK_SIZE=4096
CONFIG_MASTER_NODE_ID=1
CONFIG_MAIN_THREAD_PRIORITY=5
CONFIG_REBOOT=y
CONFIG_CONSOLE_SUBSYS=y
CONFIG_CONSOLE_GETLINE=y
```

## src/main.c
```c
/*
 * main.c - CANopenNode v4 MASTER (Panel Controller) on Zephyr - Network_B CANopen POC
 *
 * Based on CANopenNode/example/main_blank.c
 * (Copyright 2021 Janez Paternoster, Apache-2.0).
 *
 * Threads
 *   main           : stack init, communication-reset loop, CO_process() every ~1 ms,
 *                    prints the Health/Status received from TRM 1 (RPDO1/RPDO2)
 *   tmrTask_thread : SYNC / RPDO / TPDO processing every 1 ms (higher priority)
 *
 * SPDX-License-Identifier: Apache-2.0
 */

#include <string.h>
#include <zephyr/kernel.h>
#include <zephyr/device.h>
#include <zephyr/drivers/can.h>
#include <zephyr/sys/reboot.h>     /* sys_reboot() for NMT reset node */
#include <zephyr/logging/log.h>

#include "CANopen.h"
#include "OD.h"
#include "CO_storageBlank.h"
#include "app_uart.h"

LOG_MODULE_REGISTER(main, LOG_LEVEL_INF);

#define log_printf(...) LOG_INF(__VA_ARGS__)

/* default values for CO_CANopenInit() */
/* master: goes operational by itself */
#define NMT_CONTROL          (CO_NMT_STARTUP_TO_OPERATIONAL | CO_NMT_ERR_ON_ERR_REG | \
                              CO_ERR_REG_GENERIC_ERR | CO_ERR_REG_COMMUNICATION)
#define FIRST_HB_TIME        500
#define SDO_SRV_TIMEOUT_TIME 1000
#define SDO_CLI_TIMEOUT_TIME 500
#define SDO_CLI_BLOCK        false
#define OD_STATUS_BITS       NULL

#define CAN_BITRATE_KBPS     500
#if SYS_CONST_DEBUG
extern struct k_msgq dbg_rx_q;
CO_CANrxMsg_t m;
#endif

/* Global variables and objects */
CO_t* CO = NULL; /* CANopen object */

/* last printed values received from TRM 1 */
static uint8_t  health_last[3];       /* TEC, REC, alive */
static uint32_t status_last[2];       /* alive, state */
static int64_t  lastDiag_ms = 0;        /* last time the CAN controller state was printed */


typedef struct {
    uint8_t  health[3];    /* TEC, REC, alive */
    uint32_t status[2];    /* alive, state    */
} Buffer_t;

typedef struct {
    uint8_t  node;
    Buffer_t now;
    Buffer_t last;
} TRM_t;

static TRM_t trm[] = { { .node = 2 }, { .node = 3 }, { .node = 4 }, { .node = 5 } };

static void trm_print(TRM_t *t)
{
    if (memcmp(t->now.health, t->last.health, sizeof(t->now.health)) != 0) {
        memcpy(t->last.health, t->now.health, sizeof(t->now.health));
        log_printf("RX Health 0x%03X from TRM%u: TEC %u, REC %u, alive %u",
                   0x180U + t->node, t->node,
                   t->now.health[0], t->now.health[1], t->now.health[2]);
    }
    if (memcmp(t->now.status, t->last.status, sizeof(t->now.status)) != 0) {
        memcpy(t->last.status, t->now.status, sizeof(t->now.status));
        log_printf("RX Status 0x%03X from TRM%u: alive %u, state %u",
                   0x280U + t->node, t->node,
                   t->now.status[0], t->now.status[1]);
    }
}

/* main ***********************************************************************/
int
main(void) {
    CO_ReturnError_t err;
    CO_NMT_reset_cmd_t reset = CO_RESET_NOT;
    uint32_t heapMemoryUsed;

    /* CAN controller from the devicetree (chosen zephyr,canbus = FlexCAN on the FRDM-MCXN236) */
    const struct device *can_dev = DEVICE_DT_GET(DT_CHOSEN(zephyr_canbus));
    void* CANptr = (void*)can_dev;                  /* handed to the stack, used by CO_driver.c */

    uint8_t pendingNodeId = CONFIG_MASTER_NODE_ID;  /* master's own node-ID (not a TRM ID) */
    uint8_t activeNodeId = CONFIG_MASTER_NODE_ID;   /* copied from pendingNodeId in the reset section */
    uint16_t pendingBitRate = CAN_BITRATE_KBPS;

    if (!device_is_ready(can_dev)) {
        log_printf("Error: CAN device %s not ready", can_dev->name);
        return 0;
    }
    log_printf("CAN device: %s", can_dev->name);

#if (CO_CONFIG_STORAGE) & CO_CONFIG_STORAGE_ENABLE
    CO_storage_t storage;
    CO_storage_entry_t storageEntries[] = {{.addr = &OD_PERSIST_COMM,
                                            .len = sizeof(OD_PERSIST_COMM),
                                            .subIndexOD = 2,
                                            .attr = CO_storage_cmd | CO_storage_restore,
                                            .addrNV = NULL}};
    uint8_t storageEntriesCount = sizeof(storageEntries) / sizeof(storageEntries[0]);
    uint32_t storageInitError = 0;
#endif

    /* Allocate memory */
    CO_config_t* config_ptr = NULL;
#ifdef CO_MULTIPLE_OD
    /* example usage of CO_MULTIPLE_OD (but still single OD here) */
    CO_config_t co_config = {0};
    OD_INIT_CONFIG(co_config); /* helper macro from OD.h */
    co_config.CNT_LEDS = 1;
    co_config.CNT_LSS_SLV = 1;
    config_ptr = &co_config;
#endif /* CO_MULTIPLE_OD */
    CO = CO_new(config_ptr, &heapMemoryUsed);
    if (CO == NULL) {
        log_printf("Error: Can't allocate memory");
        return 0;
    } else {
        log_printf("Allocated %u bytes for CANopen objects", heapMemoryUsed);
    }

#if (CO_CONFIG_STORAGE) & CO_CONFIG_STORAGE_ENABLE
    err = CO_storageBlank_init(&storage, CO->CANmodule, OD_ENTRY_H1010_storeParameters,
                               OD_ENTRY_H1011_restoreDefaultParameters, storageEntries, storageEntriesCount,
                               &storageInitError);

    if (err != CO_ERROR_NO && err != CO_ERROR_DATA_CORRUPT) {
        log_printf("Error: Storage %u", storageInitError);
        return 0;
    }
#endif

    while (reset != CO_RESET_APP) {
        /* CANopen communication reset - initialize CANopen objects *******************/
        log_printf("CANopenNode - Reset communication...");

        /* Stop the real-time thread from processing PDOs while the stack is rebuilt.
         * Done under the OD lock: the RT thread holds this lock while it processes,
         * so once we have it, the RT thread is guaranteed to be between iterations. */
        CO_LOCK_OD(CO->CANmodule);
        CO->CANmodule->CANnormal = false;
        CO_UNLOCK_OD(CO->CANmodule);

        /* Enter CAN configuration. */
        CO_CANsetConfigurationMode(CANptr);
        CO_CANmodule_disable(CO->CANmodule);

        /* initialize CANopen */
        err = CO_CANinit(CO, CANptr, pendingBitRate);
        if (err != CO_ERROR_NO) {
            log_printf("Error: CAN initialization failed: %d", err);
            return 0;
        }

        CO_LSS_address_t lssAddress = {.identity = {.vendorID = OD_PERSIST_COMM.x1018_identity.vendor_ID,
                                                    .productCode = OD_PERSIST_COMM.x1018_identity.productCode,
                                                    .revisionNumber = OD_PERSIST_COMM.x1018_identity.revisionNumber,
                                                    .serialNumber = OD_PERSIST_COMM.x1018_identity.serialNumber}};
        err = CO_LSSinit(CO, &lssAddress, &pendingNodeId, &pendingBitRate);
        if (err != CO_ERROR_NO) {
            log_printf("Error: LSS slave initialization failed: %d", err);
            return 0;
        }

        activeNodeId = pendingNodeId;
        uint32_t errInfo = 0;

        err = CO_CANopenInit(CO,                   /* CANopen object */
                             NULL,                 /* alternate NMT */
                             NULL,                 /* alternate em */
                             OD,                   /* Object dictionary */
                             OD_STATUS_BITS,       /* Optional OD_statusBits */
                             NMT_CONTROL,          /* CO_NMT_control_t */
                             FIRST_HB_TIME,        /* firstHBTime_ms */
                             SDO_SRV_TIMEOUT_TIME, /* SDOserverTimeoutTime_ms */
                             SDO_CLI_TIMEOUT_TIME, /* SDOclientTimeoutTime_ms */
                             SDO_CLI_BLOCK,        /* SDOclientBlockTransfer */
                             activeNodeId, &errInfo);
        if (err != CO_ERROR_NO && err != CO_ERROR_NODE_ID_UNCONFIGURED_LSS) {
            if (err == CO_ERROR_OD_PARAMETERS) {
                log_printf("Error: Object Dictionary entry 0x%X", errInfo);
            } else {
                log_printf("Error: CANopen initialization failed: %d", err);
            }
            return 0;
        }

        err = CO_CANopenInitPDO(CO, CO->em, OD, activeNodeId, &errInfo);
        if (err != CO_ERROR_NO && err != CO_ERROR_NODE_ID_UNCONFIGURED_LSS) {
            if (err == CO_ERROR_OD_PARAMETERS) {
                log_printf("Error: Object Dictionary entry 0x%X", errInfo);
            } else {
                log_printf("Error: PDO initialization failed: %d", err);
            }
            return 0;
        }

        /* 1 ms timer processing: tmrTask_thread runs continuously (K_THREAD_DEFINE below) */
        /* CAN TX/RX interrupts: handled by the Zephyr driver, see CO_driver.c */

        /* Configure CANopen callbacks, etc */
        if (!CO->nodeIdUnconfigured) {

#if (CO_CONFIG_STORAGE) & CO_CONFIG_STORAGE_ENABLE
            if (storageInitError != 0) {
                CO_errorReport(CO->em, CO_EM_NON_VOLATILE_MEMORY, CO_EMC_HARDWARE, storageInitError);
            }
#endif
        } else {
            log_printf("CANopenNode - Node-id not initialized");
        }

        /* start CAN */
        CO_CANsetNormalMode(CO->CANmodule);

        reset = CO_RESET_NOT;

        log_printf("CANopenNode master - Running, node-ID %u", activeNodeId);

        int64_t lastTicks = k_uptime_ticks();      /* time of the previous loop pass */
        bool nmtStartSent = false;

        while (reset == CO_RESET_NOT) {
            /* loop for normal program execution ******************************************/
            /* get time difference since last function call */

            
            int64_t nowTicks = k_uptime_ticks();
            uint32_t timeDifference_us = (uint32_t)k_ticks_to_us_floor64(nowTicks - lastTicks);
            lastTicks = nowTicks;

            /* CANopen process */
            reset = CO_process(CO, false, timeDifference_us, NULL);
            /* DIAG: CAN controller state every 2 s */
            if ((k_uptime_get() - lastDiag_ms) >= 2000) {
                struct can_bus_err_cnt ec = {0};
                enum can_state st;
                if (nmtStartSent == false) {
                    CO_NMT_sendCommand(CO->NMT, CO_NMT_ENTER_OPERATIONAL, 0);
                    log_printf("NMT start sent to all nodes");
                    nmtStartSent = true;
                }

                lastDiag_ms = k_uptime_get();
                (void)can_get_state(can_dev, &st, &ec);     
                log_printf("CAN state %d (0=active 1=warning 2=passive 3=bus-off), TEC %u, REC %u",
                           st, ec.tx_err_cnt, ec.rx_err_cnt);
            }

            /* Nonblocking application code may go here. */
            /* read OD data: copy under the OD lock, print outside it
             * (member names must match the generated OD.h - search for x2001 / x2002) */
             

            CO_LOCK_OD(CO->CANmodule);
           /* TRM2: RPDO1/2 -> 0x2001 / 0x2002 */
            trm[0].now.health[0] = OD_RAM.x2001_TRM2_Health.TX_Error_Counter;
            trm[0].now.health[1] = OD_RAM.x2001_TRM2_Health.RX_Error_Counter;
            trm[0].now.health[2] = OD_RAM.x2001_TRM2_Health.alive_Counter;
            trm[0].now.status[0] = OD_RAM.x2002_TRM2_Status.alive_Counter;
            trm[0].now.status[1] = OD_RAM.x2002_TRM2_Status.state;

            /* TRM3: 0x2003 / 0x2006 */
            trm[1].now.health[0] = OD_RAM.x2003_TRM3_Health.TX_Error_Counter;
            trm[1].now.health[1] = OD_RAM.x2003_TRM3_Health.RX_Error_Counter;
            trm[1].now.health[2] = OD_RAM.x2003_TRM3_Health.alive_Counter;
            trm[1].now.status[0] = OD_RAM.x2006_TRM3_Status.alive_Counter;
            trm[1].now.status[1] = OD_RAM.x2006_TRM3_Status.state;

            /* TRM4: 0x2004 / 0x2007 */
            trm[2].now.health[0] = OD_RAM.x2004_TRM4_Health.TX_Error_Counter;
            trm[2].now.health[1] = OD_RAM.x2004_TRM4_Health.RX_Error_Counter;
            trm[2].now.health[2] = OD_RAM.x2004_TRM4_Health.alive_Counter;
            trm[2].now.status[0] = OD_RAM.x2007_TRM4_Status.alive_Counter;
            trm[2].now.status[1] = OD_RAM.x2007_TRM4_Status.state;

            /* TRM5: 0x2005 / 0x2008 */
            trm[3].now.health[0] = OD_RAM.x2005_TRM5_Health.TX_Error_Counter;
            trm[3].now.health[1] = OD_RAM.x2005_TRM5_Health.RX_Error_Counter;
            trm[3].now.health[2] = OD_RAM.x2005_TRM5_Health.alive_Counter;
            trm[3].now.status[0] = OD_RAM.x2008_TRM5_Status.alive_Counter;
            trm[3].now.status[1] = OD_RAM.x2008_TRM5_Status.state;
            CO_UNLOCK_OD(CO->CANmodule);
            trm_print(&trm[0]);
            trm_print(&trm[1]);
            trm_print(&trm[2]);
            trm_print(&trm[3]);
            #if SYS_CONST_DEBUG

            while (k_msgq_get(&dbg_rx_q, &m, K_NO_WAIT) == 0) {
            log_printf("bus 0x%03X [%u] %02X %02X %02X %02X %02X %02X %02X %02X",
               m.ident & 0x7FFU, m.DLC,
               m.data[0], m.data[1], m.data[2], m.data[3],
               m.data[4], m.data[5], m.data[6], m.data[7]);
            }
            #endif

            /* print only when a new RPDO changed the values */
            
            /* next step: process BF_Config requests from App_Uart (SDO client) */

            /* Process automatic storage */
            /* (not used: blank storage) */

            /* optional sleep for short time */
            k_msleep(1);
        }
    }

    /* program exit ***************************************************************/
    /* reached only on CO_RESET_APP (NMT "reset node"): restart the whole MCU */
    log_printf("CANopenNode - Reset node");

    /* delete objects from memory */
    CO_CANsetConfigurationMode(CANptr);
    CO_delete(CO);

    /* reset */
    sys_reboot(SYS_REBOOT_COLD);

    return 0;   /* not reached */
}

/* timer thread executes in constant intervals ********************************/
#define RT_THREAD_PERIOD_MS   1
#define RT_THREAD_STACK_SIZE  2048
#define RT_THREAD_PRIORITY    2      /* higher than main (CONFIG_MAIN_THREAD_PRIORITY=5) */

static void
tmrTask_thread(void* p1, void* p2, void* p3) {
    ARG_UNUSED(p1);
    ARG_UNUSED(p2);
    ARG_UNUSED(p3);

    int64_t next_ms = k_uptime_get();
    int64_t lastTicks = k_uptime_ticks();

    for (;;) {
        /* sleep until the next 1 ms deadline (absolute: no drift) */
        next_ms += RT_THREAD_PERIOD_MS;
        k_sleep(K_TIMEOUT_ABS_MS(next_ms));

        /* get time difference since last function call */
        int64_t nowTicks = k_uptime_ticks();
        uint32_t timeDifference_us = (uint32_t)k_ticks_to_us_floor64(nowTicks - lastTicks);
        lastTicks = nowTicks;

        if (CO == NULL) {
            continue;   /* main() has not created the stack yet */
        }

        CO_LOCK_OD(CO->CANmodule);
        if (!CO->nodeIdUnconfigured && CO->CANmodule->CANnormal) {
            bool_t syncWas = false;

#if (CO_CONFIG_SYNC) & CO_CONFIG_SYNC_ENABLE
            syncWas = CO_process_SYNC(CO, timeDifference_us, NULL);
#endif
#if (CO_CONFIG_PDO) & CO_CONFIG_RPDO_ENABLE
            CO_process_RPDO(CO, syncWas, timeDifference_us, NULL);
#endif
#if (CO_CONFIG_PDO) & CO_CONFIG_TPDO_ENABLE
            CO_process_TPDO(CO, syncWas, timeDifference_us, NULL);
#endif

            /* Further I/O or nonblocking application code may go here. */
        }
        CO_UNLOCK_OD(CO->CANmodule);

        /* fell behind (e.g. debugger stop): don't burst to catch up */
        if (next_ms < k_uptime_get()) {
            next_ms = k_uptime_get();
        }
    }
}

/* started once at boot by Zephyr */
K_THREAD_DEFINE(tmrTask_id, RT_THREAD_STACK_SIZE, tmrTask_thread, NULL, NULL, NULL,
                RT_THREAD_PRIORITY, 0, 0);
```

## src/CO_driver.c
```c
/*
 * CAN module object for generic microcontroller.
 *
 * This file is a template for other microcontrollers.
 *
 * @file        CO_driver.c
 * @ingroup     CO_driver
 * @author      Janez Paternoster
 * @copyright   2004 - 2020 Janez Paternoster
 *
 * This file is part of <https://github.com/CANopenNode/CANopenNode>, a CANopen Stack.
 *
 * Licensed under the Apache License, Version 2.0 (the "License"); you may not use this
 * file except in compliance with the License. You may obtain a copy of the License at
 *
 *     http://www.apache.org/licenses/LICENSE-2.0
 *
 * Unless required by applicable law or agreed to in writing, software distributed under the License is
 * distributed on an "AS IS" BASIS, WITHOUT WARRANTIES OR CONDITIONS OF ANY KIND, either express or implied.
 * See the License for the specific language governing permissions and limitations under the License.
 */

#include <string.h>
#include <zephyr/kernel.h>
#include <zephyr/drivers/can.h>
#include <zephyr/logging/log.h>

#include "301/CO_driver.h"

LOG_MODULE_REGISTER(co_driver, LOG_LEVEL_INF);
#define SYS_CONST_DEBUG 1
/* Mutexes behind the CO_LOCK_* macros in CO_driver_target.h */
K_MUTEX_DEFINE(CO_send_mutex);
K_MUTEX_DEFINE(CO_emcy_mutex);
K_MUTEX_DEFINE(CO_od_mutex);

#if SYS_CONST_DEBUG
K_MSGQ_DEFINE(dbg_rx_q, sizeof(CO_CANrxMsg_t), 64, 4);   /* at file scope */
#endif
static void CO_CANrx_isr(const struct device* dev, struct can_frame* frame, void* user_data);
static void CO_CANtx_isr(const struct device* dev, int error, void* user_data);
static void CO_CANtx_retry(struct k_work* work);
static int  send_to_hw(CO_CANmodule_t* CANmodule, const CO_CANtx_t* buffer);

void
CO_CANsetConfigurationMode(void* CANptr) {
    /* Put CAN module in configuration mode */
    const struct device *dev = CANptr;
    if(dev != NULL)
    {
        (void)can_stop(dev); /* Stop CAN device */
        /* Set CAN module to configuration mode */
    }

}

void
CO_CANsetNormalMode(CO_CANmodule_t* CANmodule) {
    /* Put CAN module in normal mode */
    const struct device *dev = CANmodule->CANptr;
    int err = can_start(dev);

    /* Put CAN module in normal mode */
    if ((err == 0) || (err == -EALREADY)) {
        CANmodule->CANnormal = true;
    } else {
        LOG_ERR("CO_driver: can_start failed (%d)\n", err);
    }
}

CO_ReturnError_t
CO_CANmodule_init(CO_CANmodule_t* CANmodule, void* CANptr, CO_CANrx_t rxArray[], uint16_t rxSize, CO_CANtx_t txArray[],
                  uint16_t txSize, uint16_t CANbitRate) {
    uint16_t i;
    int err;
    const struct device *dev = CANptr;

    /* verify arguments */
    if (CANmodule == NULL || dev == NULL || rxArray == NULL || txArray == NULL) {
        LOG_ERR("CO_driver: CO_CANmodule_init failed (NULL argument)\n");
        return CO_ERROR_ILLEGAL_ARGUMENT;
        
    }
    //zephyr is ready
     if (!device_is_ready(dev)) {
        LOG_ERR("CO_driver: CAN device not ready\n");
        return CO_ERROR_ILLEGAL_ARGUMENT;
    }

    if (CANmodule->txWorkInitialised) {
        struct k_work_sync sync;

        /* remove a pending retry and wait for a running one to finish,
         * so k_work_init() below is safe */
        k_work_cancel_sync(&CANmodule->txRetryWork, &sync);
    }
    if (CANmodule->rxFilterAdded) {
        can_remove_rx_filter(dev, CANmodule->rxFilterId);
        CANmodule->rxFilterAdded = false;
    }

    

    /* Configure object variables */
    CANmodule->CANptr = CANptr;
    CANmodule->rxArray = rxArray;
    CANmodule->rxSize = rxSize;
    CANmodule->txArray = txArray;
    CANmodule->txSize = txSize;
    CANmodule->CANerrorStatus = 0;
    CANmodule->CANnormal = false;
    CANmodule->useCANrxFilters = false;
    CANmodule->bufferInhibitFlag = false;
    CANmodule->firstCANtxMessage = true;
    CANmodule->CANtxCount = 0U;
    CANmodule->errOld = 0U;

    for (i = 0U; i < rxSize; i++) {
        rxArray[i].ident = 0U;
        rxArray[i].mask = 0xFFFFU;
        rxArray[i].object = NULL;
        rxArray[i].CANrx_callback = NULL;
    }
    for (i = 0U; i < txSize; i++) {
        txArray[i].bufferFull = false;
    }
       k_work_init(&CANmodule->txRetryWork, CO_CANtx_retry);
        CANmodule->txWorkInitialised = true;

    /* Configure CAN module registers */
    err = can_set_mode(dev, CAN_MODE_NORMAL);   /* CAN_MODE_LOOPBACK for single-board tests */
    if (err != 0) {
        LOG_ERR("CO_driver: can_set_mode failed (%d)\n", err);
        return CO_ERROR_ILLEGAL_ARGUMENT;
    }


    /* Configure CAN timing */
    err = can_set_bitrate(dev, (uint32_t)CANbitRate*1000U);  //kbps - bps
    if(err != 0) {
        LOG_ERR("CO_driver: can_set_bitrate failed (%d)\n", err);
        return CO_ERROR_ILLEGAL_BAUDRATE;
    }

    /* Configure CAN module hardware filters */
    if (CANmodule->useCANrxFilters) {
        /* CAN module filters are used, they will be configured with */
        /* CO_CANrxBufferInit() functions, called by separate CANopen */
        /* init functions. */
        /* Configure all masks so, that received CAN frame must match filter */
    } else {
        struct can_filter filter = {
            .id = 0,
            .mask = 0,
            .flags=0
        };
        /* CAN module filters are not used, all CAN frames with standard 11-bit */
        /* identifier will be received */
        /* Configure mask 0 so, that all CAN frames with standard identifier are accepted */
        /* configure CAN interrupt registers */
    err = can_add_rx_filter(dev, CO_CANrx_isr, CANmodule, &filter);

        if (err < 0) {
            LOG_ERR("CO_driver: can_add_rx_filter failed (%d)\n", err);
            return CO_ERROR_ILLEGAL_ARGUMENT;
        }
        CANmodule->rxFilterId = err;
        CANmodule->rxFilterAdded = true;
    }

    

    return CO_ERROR_NO;
}

void
CO_CANmodule_disable(CO_CANmodule_t* CANmodule) {
    int err;
     

    if ((CANmodule == NULL) || (CANmodule->CANptr == NULL)) {
        return;
    }

    err = can_stop(CANmodule->CANptr);
    if ((err != 0) && (err != -EALREADY)) {
        LOG_ERR("can_stop failed (%d)", err);
    }

    if (CANmodule->rxFilterAdded) {
        can_remove_rx_filter(CANmodule->CANptr, CANmodule->rxFilterId);
        CANmodule->rxFilterAdded = false;
    }

    CANmodule->CANnormal = false;
}

CO_ReturnError_t
CO_CANrxBufferInit(CO_CANmodule_t* CANmodule, uint16_t index, uint16_t ident, uint16_t mask, bool_t rtr, void* object,
                   void (*CANrx_callback)(void* object, void* message)) {
   CO_ReturnError_t ret = CO_ERROR_NO;

    if ((CANmodule != NULL) && (object != NULL) && (CANrx_callback != NULL) && (index < CANmodule->rxSize)) {
        /* buffer, which will be configured */
        CO_CANrx_t* buffer = &CANmodule->rxArray[index];

        /* Turn the entry OFF while it is changed: the RX interrupt skips
         * entries with a NULL callback (needed when the stack reconfigures
         * an RX buffer while CAN is running, e.g. RPDO COB-ID changed via SDO). */
        buffer->CANrx_callback = NULL;
        CO_MemoryBarrier();

        /* Configure object variables */
        buffer->object = object;

        /* CAN identifier and mask; bit 11 (0x0800) represents RTR */
        buffer->ident = ident & 0x07FFU;
        if (rtr) {
            buffer->ident |= 0x0800U;
        }
        buffer->mask = (mask & 0x07FFU) | 0x0800U;   /* RTR bit must always match */

        /* Set CAN hardware module filter and mask. */
        if (CANmodule->useCANrxFilters) {
            /* Not used in the POC: one catch-all filter is added in CO_CANmodule_init()
             * and frames are matched in software in the RX callback. */
        }

        /* Turn the entry ON last, once all fields are consistent */
        CO_MemoryBarrier();
        buffer->CANrx_callback = CANrx_callback;
    } else {
        LOG_ERR("CO_CANrxBufferInit: illegal argument (index %u)", index);
        ret = CO_ERROR_ILLEGAL_ARGUMENT;
    }

    return ret;
}

CO_CANtx_t*
CO_CANtxBufferInit(CO_CANmodule_t* CANmodule, uint16_t index, uint16_t ident, bool_t rtr, uint8_t noOfBytes,
                   bool_t syncFlag) {
    CO_CANtx_t* buffer = NULL;

    if ((CANmodule != NULL) && (index < CANmodule->txSize)) {
        /* get specific buffer */
        buffer = &CANmodule->txArray[index];

        /* Alligned with Zephyr structure */
       buffer->ident = (uint32_t)ident & 0x07FFU;
        if (rtr) {
            buffer->ident |= 0x0800U;
        }
        buffer->DLC = (noOfBytes > 8U) ? 8U : noOfBytes;   /* classic CAN: max 8 bytes */
        buffer->bufferFull = false;
        buffer->syncFlag = syncFlag;
    }

    return buffer;
}

/* Build a Zephyr frame from a CANopenNode TX buffer and hand it to the driver.
 * Returns the Zephyr result: 0 = accepted, -EAGAIN = no free mailbox, <0 = error. */
static int send_to_hw(CO_CANmodule_t *CANmodule, const CO_CANtx_t *buffer)
{
	struct can_frame frame = {0};

	frame.id    = buffer->ident & 0x07FFU;
	frame.flags = ((buffer->ident & 0x0800U) != 0U) ? CAN_FRAME_RTR : 0U;
	frame.dlc   = buffer->DLC;
	memcpy(frame.data, buffer->data, buffer->DLC);

	return can_send(CANmodule->CANptr, &frame, K_NO_WAIT, CO_CANtx_isr, CANmodule);
}

CO_ReturnError_t
CO_CANsend(CO_CANmodule_t* CANmodule, CO_CANtx_t* buffer) {
    CO_ReturnError_t err = CO_ERROR_NO;   /* CANopen result returned to the stack */
    int ret;                              /* Zephyr result of can_send() */

    /* Verify overflow: previous frame in this buffer not sent yet */
    if (buffer->bufferFull) {
        if (!CANmodule->firstCANtxMessage) {
            /* don't set error, if bootup message is still on buffers */
            CANmodule->CANerrorStatus |= CO_CAN_ERRTX_OVERFLOW;
        }
        LOG_WRN("TX overflow, ID 0x%03X", (unsigned)(buffer->ident & 0x07FFU));
        err = CO_ERROR_TX_OVERFLOW;
    }

    CO_LOCK_CAN_SEND(CANmodule);

    /* Send now only if nothing is queued (keeps order) */
    if (CANmodule->CANtxCount == 0U) {
        ret = send_to_hw(CANmodule, buffer);
    } else {
        ret = -EAGAIN;                    /* older frames waiting: queue behind them */
    }

    if (ret == 0) {
        /* accepted by a hardware mailbox */
        CANmodule->bufferInhibitFlag = buffer->syncFlag;
    } else {
        if (ret != -EAGAIN) {
            /* e.g. -ENETUNREACH (bus-off): keep it queued, it is sent once the
             * bus recovers; CO_CANmodule_process() reports the bus state */
            LOG_WRN("can_send failed (%d), frame queued", ret);
        }
        /* queue it; the TX-done callback triggers sending the queue */
        if (!buffer->bufferFull) {
            buffer->bufferFull = true;
            CANmodule->CANtxCount++;
        }
    }

    CO_UNLOCK_CAN_SEND(CANmodule);

    return err;
}
void
CO_CANclearPendingSyncPDOs(CO_CANmodule_t* CANmodule) {
    uint32_t tpdoDeleted = 0U;

    CO_LOCK_CAN_SEND(CANmodule);
    /* Abort frame from CAN module, if there is synchronous TPDO.
     * Take special care with this functionality. */
    if (/* CAN frameIsOnCanBuffer && */ CANmodule->bufferInhibitFlag) {
        /* clear TXREQ */
        CANmodule->bufferInhibitFlag = false;
        tpdoDeleted = 1U;
    }
    /* delete also pending synchronous TPDOs in TX buffers */
    if (CANmodule->CANtxCount != 0U) {
        uint16_t i;
        CO_CANtx_t* buffer = &CANmodule->txArray[0];
        for (i = CANmodule->txSize; i > 0U; i--) {
            if (buffer->bufferFull) {
                if (buffer->syncFlag) {
                    buffer->bufferFull = false;
                    CANmodule->CANtxCount--;
                    tpdoDeleted = 2U;
                }
            }
            buffer++;
        }
    }
    CO_UNLOCK_CAN_SEND(CANmodule);

    if (tpdoDeleted != 0U) {
        CANmodule->CANerrorStatus |= CO_CAN_ERRTX_PDO_LATE;
    }
}

/* Get error counters from the module. If necessary, function may use different way to determine errors. */
//static uint16_t rxErrors = 0, txErrors = 0, overflow = 0;


void CO_CANmodule_process(CO_CANmodule_t* CANmodule) {
    uint32_t err;
    enum can_state state;
    struct can_bus_err_cnt err_cnt;
    uint32_t overflow = 0;
    int ret;
    
    ret = can_get_state(CANmodule->CANptr, &state, &err_cnt);
    if (ret != 0) {
        LOG_ERR("Unable to get CAN state %d", ret);
        return;                         /* state / err_cnt not valid */
    }
    err = ((uint32_t)err_cnt.tx_err_cnt << 16) | ((uint32_t)err_cnt.rx_err_cnt << 8) | overflow;
    if (state == CAN_STATE_BUS_OFF) {
        err |= 0x80000000U;             /* TEC is 8-bit and cannot show bus-off */
    }
    if (CANmodule->errOld != err) {
        uint16_t status = CANmodule->CANerrorStatus;

        CANmodule->errOld = err;

        if (state == CAN_STATE_BUS_OFF) {
            /* bus off */
            status |= CO_CAN_ERRTX_BUS_OFF;
        } else {
            /* recalculate CANerrorStatus, first clear some flags */
            status &= 0xFFFF
                      ^ (CO_CAN_ERRTX_BUS_OFF | CO_CAN_ERRRX_WARNING | CO_CAN_ERRRX_PASSIVE | CO_CAN_ERRTX_WARNING
                         | CO_CAN_ERRTX_PASSIVE);

            /* rx bus warning or passive */
            if (err_cnt.rx_err_cnt >= 128) {
                status |= CO_CAN_ERRRX_WARNING | CO_CAN_ERRRX_PASSIVE;
            } else if (err_cnt.rx_err_cnt >= 96) {
                status |= CO_CAN_ERRRX_WARNING;
            }

            /* tx bus warning or passive */
            if (err_cnt.tx_err_cnt >= 128) {
                status |= CO_CAN_ERRTX_WARNING | CO_CAN_ERRTX_PASSIVE;
            } else if (err_cnt.tx_err_cnt >= 96) {
                status |= CO_CAN_ERRTX_WARNING;
            }

            /* if not tx passive clear also overflow */
            if ((status & CO_CAN_ERRTX_PASSIVE) == 0) {
                status &= 0xFFFF ^ CO_CAN_ERRTX_OVERFLOW;
            }
        }

        if (overflow != 0) {
            /* CAN RX bus overflow */
            status |= CO_CAN_ERRRX_OVERFLOW;
        }

        CANmodule->CANerrorStatus = status;
    }

    /* Safety net: restart the TX queue if frames are waiting but no TX-done
     * interrupt will come to trigger it (e.g. frames queued during bus-off). */
    if ((CANmodule->CANtxCount > 0U) && (state != CAN_STATE_BUS_OFF)) {
        k_work_submit(&CANmodule->txRetryWork);
    }
}



/* Replaces the "transmit interrupt" branch of the template's CO_CANinterrupt().
 * Called by the Zephyr CAN driver (given to can_send()) when a frame was sent
 * or failed. Runs in interrupt context: it may not take CO_LOCK_CAN_SEND (a mutex),
 * so sending the queue is handed to a work item that runs in a thread. */
static void
CO_CANtx_isr(const struct device *dev, int error, void *user_data) {
    CO_CANmodule_t* CANmodule = user_data;   /* passed to can_send() */

    ARG_UNUSED(dev);

    if (error == 0) {
        /* First CAN frame (bootup) was sent successfully */
        CANmodule->firstCANtxMessage = false;
    }
    /* clear flag from previous CAN frame */
    CANmodule->bufferInhibitFlag = false;

    /* Are there any new CAN frames waiting to be sent? */
    if (CANmodule->CANtxCount > 0U) {
        k_work_submit(&CANmodule->txRetryWork);
    }
}

/* Work item (thread context): send queued frames in array order until the
 * hardware mailboxes are full again. */
static void
CO_CANtx_retry(struct k_work* work) {
    CO_CANmodule_t* CANmodule = CONTAINER_OF(work, CO_CANmodule_t, txRetryWork);
    uint16_t i;
    uint16_t pending = 0U;
    bool blocked = false;

    CO_LOCK_CAN_SEND(CANmodule);

    for (i = 0U; i < CANmodule->txSize; i++) {
        CO_CANtx_t* buffer = &CANmodule->txArray[i];

        if (!buffer->bufferFull) {
            continue;
        }
        if (!blocked && (send_to_hw(CANmodule, buffer) == 0)) {
            /* accepted by a mailbox */
            buffer->bufferFull = false;
            CANmodule->bufferInhibitFlag = buffer->syncFlag;
        } else {
            /* no mailbox free: keep this and all later ones queued, in order */
            blocked = true;
            pending++;
        }
    }
    CANmodule->CANtxCount = pending;

    CO_UNLOCK_CAN_SEND(CANmodule);
}
/* Replaces the "receive interrupt" branch of the template's CO_CANinterrupt().
 * Called by the Zephyr CAN driver (registered in CO_CANmodule_init() with
 * can_add_rx_filter) for every received frame. Runs in interrupt context:
 * no blocking calls, no mutexes, keep it short. */
static void
CO_CANrx_isr(const struct device* dev, struct can_frame* frame, void* user_data) {
    CO_CANmodule_t* CANmodule = user_data;   /* passed to can_add_rx_filter() */
    CO_CANrxMsg_t rcvMsg;
    uint16_t index;
    CO_CANrx_t* buffer;

    ARG_UNUSED(dev);

    /* CANopen uses standard 11-bit identifiers only */
    if ((frame->flags & CAN_FRAME_IDE) != 0U) {
        return;
    }

    /* Convert the Zephyr frame; same convention as CO_CANrxBufferInit(): bit 11 = RTR */
    rcvMsg.ident = (uint16_t)(frame->id & 0x07FFU);
    if ((frame->flags & CAN_FRAME_RTR) != 0U) {
        rcvMsg.ident |= 0x0800U;
    }
    rcvMsg.DLC = (frame->dlc > 8U) ? 8U : frame->dlc;
    memcpy(rcvMsg.data, frame->data, rcvMsg.DLC);
    #if SYS_CONST_DEBUG
    if (rcvMsg.ident >= 0x0E0U && rcvMsg.ident <= 0x0FFU) {
    (void)k_msgq_put(&dbg_rx_q, &rcvMsg, K_NO_WAIT);   /* drop if full, never block */
    }
    #endif

    /* Catch-all filter: search rxArray for the same CAN-ID; skip unused entries */
    buffer = &CANmodule->rxArray[0];
    for (index = CANmodule->rxSize; index > 0U; index--) {
        void (*callback)(void* object, void* message) = buffer->CANrx_callback;

        if ((callback != NULL) && (((rcvMsg.ident ^ buffer->ident) & buffer->mask) == 0U)) {
            callback(buffer->object, (void*)&rcvMsg);
            break;
        }
        buffer++;
    }
}
```

## src/CO_driver_target.h
```c
/*
 * Device and application specific definitions for CANopenNode.
 *
 * @file        CO_driver_target.h
 * @author      Janez Paternoster
 * @copyright   2021 Janez Paternoster
 *
 * This file is part of <https://github.com/CANopenNode/CANopenNode>, a CANopen Stack.
 *
 * Licensed under the Apache License, Version 2.0 (the "License"); you may not use this
 * file except in compliance with the License. You may obtain a copy of the License at
 *
 *     http://www.apache.org/licenses/LICENSE-2.0
 *
 * Unless required by applicable law or agreed to in writing, software distributed under the License is
 * distributed on an "AS IS" BASIS, WITHOUT WARRANTIES OR CONDITIONS OF ANY KIND, either express or implied.
 * See the License for the specific language governing permissions and limitations under the License.
 */

#ifndef CO_DRIVER_TARGET_H
#define CO_DRIVER_TARGET_H

/* This file contains device and application specific definitions. It is included from CO_driver.h, which contains
 * documentation for common definitions below. */

#include <stddef.h>
#include <stdbool.h>
#include <stdint.h>
#include <zephyr/kernel.h>        /* struct k_work, struct k_mutex */
#include <zephyr/drivers/can.h>
#include <zephyr/sys/barrier.h>   /* barrier_dmem_fence_full() */

#ifdef CO_DRIVER_CUSTOM
#include "CO_driver_custom.h"
#endif

#ifdef __cplusplus
extern "C" {
#endif

/* Stack configuration override default values. For more information see file CO_config.h. */

/* MASTER only: SDO client (segmented transfer for > 4 bytes) and the FIFO it needs */
#define CO_CONFIG_SDO_CLI (CO_CONFIG_SDO_CLI_ENABLE | CO_CONFIG_SDO_CLI_SEGMENTED | \
                           CO_CONFIG_SDO_CLI_LOCAL | CO_CONFIG_GLOBAL_FLAG_CALLBACK_PRE | \
                           CO_CONFIG_GLOBAL_FLAG_TIMERNEXT)
#define CO_CONFIG_FIFO    (CO_CONFIG_FIFO_ENABLE)
#define CO_CONFIG_NMT  (CO_CONFIG_NMT_MASTER | CO_CONFIG_GLOBAL_FLAG_CALLBACK_PRE | \
                        CO_CONFIG_GLOBAL_FLAG_TIMERNEXT)
/* Basic definitions. If big endian, CO_SWAP_xx macros must swap bytes. */
#define CO_LITTLE_ENDIAN
#define CO_SWAP_16(x) x
#define CO_SWAP_32(x) x
#define CO_SWAP_64(x) x
/* NULL is defined in stddef.h */
/* true and false are defined in stdbool.h */
/* int8_t to uint64_t are defined in stdint.h */
typedef uint_fast8_t bool_t;
typedef float float32_t;
typedef double float64_t;

/* Received CAN frame, as built by CO_CANrx_isr() in CO_driver.c */
typedef struct {
    uint16_t ident;   /* 11-bit ID, bit 11 = RTR */
    uint8_t  DLC;
    uint8_t  data[8];
} CO_CANrxMsg_t;

/* Access to received CAN frame: the stack reads every received frame ONLY through
 * these macros. They must read the real fields of CO_CANrxMsg_t above.*/
 
#define CO_CANrxMsg_readIdent(msg) ((uint16_t)(((const CO_CANrxMsg_t*)(msg))->ident & 0x07FFU))
#define CO_CANrxMsg_readDLC(msg)   ((uint8_t)(((const CO_CANrxMsg_t*)(msg))->DLC))
#define CO_CANrxMsg_readData(msg)  ((const uint8_t*)(((const CO_CANrxMsg_t*)(msg))->data))

/* Received frame object */
typedef struct {
    uint16_t ident;
    uint16_t mask;
    void* object;
    void (*CANrx_callback)(void* object, void* message);
} CO_CANrx_t;

/* Transmit frame object */
typedef struct {
    uint32_t ident;
    uint8_t DLC;
    uint8_t data[8];
    volatile bool_t bufferFull;
    volatile bool_t syncFlag;
} CO_CANtx_t;

/* CAN module object */
typedef struct {
    void* CANptr;
    CO_CANrx_t* rxArray;
    uint16_t rxSize;
    CO_CANtx_t* txArray;
    uint16_t txSize;
    uint16_t CANerrorStatus;
    volatile bool_t CANnormal;
    volatile bool_t useCANrxFilters;
    volatile bool_t bufferInhibitFlag;
    volatile bool_t firstCANtxMessage;
    volatile uint16_t CANtxCount;
    uint32_t errOld;

     /* Zephyr specific */
    int rxFilterId;              /* id returned by can_add_rx_filter() */
    bool rxFilterAdded;          /* true while that filter is registered */
    struct k_work txRetryWork;   /* sends the TX queue when a mailbox frees */
    bool txWorkInitialised;      /* true once k_work_init() was called */
} CO_CANmodule_t;

/* Data storage object for one entry */
typedef struct {
    void* addr;
    size_t len;
    uint8_t subIndexOD;
    uint8_t attr;
    /* Additional variables (target specific) */
    void* addrNV;
} CO_storage_entry_t;

/* Critical sections. Used only from threads (main loop, 1 ms thread, UART thread,
 * TX retry work item), never from the CAN interrupt, so Zephyr mutexes are safe.
 * Zephyr mutexes are recursive for the owning thread and have priority inheritance.
 * The mutexes are defined once in CO_driver.c (K_MUTEX_DEFINE).
 * (The template versions were empty: several threads changed the TX queue and
 * the OD at the same time without protection.) */
extern struct k_mutex CO_send_mutex;
extern struct k_mutex CO_emcy_mutex;
extern struct k_mutex CO_od_mutex;

/* (un)lock critical section in CO_CANsend() */
#define CO_LOCK_CAN_SEND(CAN_MODULE)    k_mutex_lock(&CO_send_mutex, K_FOREVER)
#define CO_UNLOCK_CAN_SEND(CAN_MODULE)  k_mutex_unlock(&CO_send_mutex)

/* (un)lock critical section in CO_errorReport() or CO_errorReset() */
#define CO_LOCK_EMCY(CAN_MODULE)        k_mutex_lock(&CO_emcy_mutex, K_FOREVER)
#define CO_UNLOCK_EMCY(CAN_MODULE)      k_mutex_unlock(&CO_emcy_mutex)

/* (un)lock critical section when accessing Object Dictionary */
#define CO_LOCK_OD(CAN_MODULE)          k_mutex_lock(&CO_od_mutex, K_FOREVER)
#define CO_UNLOCK_OD(CAN_MODULE)        k_mutex_unlock(&CO_od_mutex)

/* Synchronization between CAN receive (interrupt) and data processing threads. */
#define CO_MemoryBarrier()  barrier_dmem_fence_full()
#define CO_FLAG_READ(rxNew) ((rxNew) != NULL)
#define CO_FLAG_SET(rxNew)                                                                                             \
    do {                                                                                                               \
        CO_MemoryBarrier();                                                                                            \
        rxNew = (void*)1L;                                                                                             \
    } while (0)
#define CO_FLAG_CLEAR(rxNew)                                                                                           \
    do {                                                                                                               \
        CO_MemoryBarrier();                                                                                            \
        rxNew = NULL;                                                                                                  \
    } while (0)

#ifdef __cplusplus
}
#endif /* __cplusplus */

#endif /* CO_DRIVER_TARGET_H */
```

## src/app_uart.c
```c
/*
 * app_uart.c - MASTER: UART command input + BF_Config download via SDO
 *
 * Type a TRM node-ID (e.g. "2") and press Enter: the master writes 8 bytes of
 * BF_Config to that TRM's OD entry 0x2000:00 using the SDO client, waits for
 * the TRM's confirmation and prints OK or the SDO abort code.
 *
 * Only this thread uses the SDO client (CO->SDOclient). CO_process() in the
 * main thread does not touch it, so no further locking is needed.
 *
 * SPDX-License-Identifier: Apache-2.0
 */
#include <stdint.h>
#include <stdlib.h>
#include <string.h>
#include <zephyr/kernel.h>
#include <zephyr/console/console.h>
#include <zephyr/sys/printk.h>
#include <zephyr/logging/log.h>
#include "CANopen.h"
#include "app_uart.h"

/* the CANopen object, created in main.c */
extern CO_t* CO;

/* BF_Config on every TRM: OD entry 0x2000, sub-index 0, 8 bytes */
#define BF_CONFIG_INDEX      0x2000U
#define BF_CONFIG_SUBINDEX   0x00U
#define BF_CONFIG_SIZE       16
#define BF_SDO_TIMEOUT_MS    1000U
//LOG_MODULE_REGISTER(main, LOG_LEVEL_INF);

//#define log_printf(...) LOG_INF(__VA_ARGS__)

#define APP_UART_STACK_SIZE  2048
#define APP_UART_PRIORITY    7      /* lowest: waits for typing almost all the time */
uint64_t BFConfig_Counter =0;
/* POC: dummy BF_Config per TRM, byte 0 = target node-ID so the TRM print shows who it was for */
static void
get_bf_config(uint8_t nodeId, uint8_t cfg[BF_CONFIG_SIZE]) {
    static const uint8_t pattern[BF_CONFIG_SIZE] = {0x00, 0x22, 0xFF, 0xAA, 0xBB, 0xCC, 0xDD, 0x10,0xAA,0xBB,0xCC,0xDD,0xEE,0xFF,0x00,0x11};

    memcpy(cfg, pattern, BF_CONFIG_SIZE);
    cfg[0] = nodeId;
    cfg[7]= BFConfig_Counter++;
}

uint32_t
bf_config_send(uint8_t nodeId, const uint8_t* cfg, size_t len) {
    CO_SDOclient_t* sdo;
    CO_SDO_abortCode_t abortCode = CO_SDO_AB_NONE;
    CO_SDO_return_t ret;

    if ((CO == NULL) || (CO->SDOclient == NULL)) {
        printk("SDO client not available (stack not running or CO_CONFIG_SDO_CLI disabled)\n");
        return (uint32_t)CO_SDO_AB_GENERAL;
    }
    sdo = CO->SDOclient;

    /* point the client at this TRM: request on 0x0C0+n, response on 0x0E0+n */
    ret = CO_SDOclient_setup(sdo, 0x0C0U + nodeId, 0x0E0U + nodeId, nodeId);
    if (ret != CO_SDO_RT_ok_communicationEnd) {
        printk("SDO setup for node %u failed (%d)\n", nodeId, ret);
        return (uint32_t)CO_SDO_AB_GENERAL;
    }

    /* start "write index:subindex, len bytes" (no block transfer for 8 bytes) */
    ret = CO_SDOclientDownloadInitiate(sdo, BF_CONFIG_INDEX, BF_CONFIG_SUBINDEX, len, BF_SDO_TIMEOUT_MS,
                                       false);
    if (ret != CO_SDO_RT_ok_communicationEnd) {
        printk("SDO download initiate for node %u failed (%d)\n", nodeId, ret);
        return (uint32_t)CO_SDO_AB_GENERAL;
    }

    /* hand over the data */
    (void)CO_SDOclientDownloadBufWrite(sdo, cfg, len);

    /* run the transfer until it ends: > 0 = in progress, 0 = done, < 0 = error */
    int64_t last = k_uptime_ticks();
    do {
        k_msleep(1);
        int64_t now = k_uptime_ticks();
        uint32_t diff_us = (uint32_t)k_ticks_to_us_floor64(now - last);
        last = now;

        ret = CO_SDOclientDownload(sdo, diff_us, false, false, &abortCode, NULL, NULL);
    } while (ret > 0);

    return (ret == CO_SDO_RT_ok_communicationEnd) ? 0U : (uint32_t)abortCode;
}

static void
app_uart_thread(void* ptr1, void* ptr2, void* ptr3) {
    ARG_UNUSED(ptr1);
    ARG_UNUSED(ptr2);
    ARG_UNUSED(ptr3);

    console_getline_init(); /* once, before the loop */
    printk("Type a TRM node-ID (1..127) and Enter to send BF_Config, e.g. 2\n");

    while (1) {
        char* line = console_getline(); /* blocks until Enter */

        if ((line == NULL) || (line[0] == '\0')) {
            continue; /* empty line: ignore */
        }

        char* end;
        long node = strtol(line, &end, 10); /* text -> number */

        if ((*end != '\0') || (node < 1) || (node > 127)) {
            printk("Invalid input '%s'. Type a node-ID 1..127, e.g. 2\n", line);
            continue;
        }

        uint8_t nodeId = (uint8_t)node;
        uint8_t cfg[BF_CONFIG_SIZE];

        get_bf_config(nodeId, cfg);
        printk("TX BF_Config to TRM%u via SDO 0x%03X: %02X %02X %02X %02X %02X %02X %02X %02X %02X %02X %02X %02X %02X %02X %02X %02X\n", nodeId,
               0x0C0U + nodeId, cfg[0], cfg[1], cfg[2], cfg[3], cfg[4], cfg[5], cfg[6], cfg[7], cfg[8], cfg[9], cfg[10], cfg[11], cfg[12], cfg[13], cfg[14], cfg[15]);

        uint32_t abortCode = bf_config_send(nodeId, cfg, sizeof(cfg));

        if (abortCode == 0U) {
            printk("BF_Config to TRM%u: OK (confirmed by the TRM)\n", nodeId);
        } else {
            printk("BF_Config to TRM%u: FAILED, SDO abort code 0x%08X\n", nodeId, abortCode);
        }
    }
}

/* defined after the function, so the name is known here; started at boot */
K_THREAD_DEFINE(app_uart_tid, APP_UART_STACK_SIZE, app_uart_thread, NULL, NULL, NULL, APP_UART_PRIORITY, 0, 0);
```

## src/app_uart.h
```c
/*
 * app_uart.h - MASTER: UART command input + BF_Config download via SDO
 *
 * SPDX-License-Identifier: Apache-2.0
 */
#ifndef APP_UART_H_
#define APP_UART_H_

#include <stddef.h>
#include <stdint.h>

/*
 * Write BF_Config to one TRM (OD 0x2000:00) via SDO and wait for the result.
 * Must only be called from one thread (the SDO client is not shared).
 * Returns 0 on success, otherwise the SDO abort code.
 */
uint32_t bf_config_send(uint8_t nodeId, const uint8_t* cfg, size_t len);



#endif /* APP_UART_H_ */
```
